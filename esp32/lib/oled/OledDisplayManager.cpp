#include <Adafruit_GFX.h>
#include <Adafruit_SSD1306.h>
#include <Adafruit_ADXL345_U.h>
#include <OledDisplayManager.h>

#define SCREEN_WIDTH 128 // OLED display width, in pixels
#define SCREEN_HEIGHT 64 // OLED display height, in pixels

// OLED Display SSD1306
Adafruit_SSD1306 OledDisplayManager::display(SCREEN_WIDTH, SCREEN_HEIGHT, &Wire, -1);

const unsigned char influxdb_bmp[] PROGMEM = {
	// 'influxdata-logo--symbol--pool-alpha-small', 16x16px
	0xfd, 0xff, 0xf8, 0x3f, 0xf2, 0x87, 0xef, 0x73, 0xdf, 0xbb, 0xbf, 0xb9, 0xbd, 0xb9, 0xbb, 0xfd,
	0xb7, 0xfd, 0x9d, 0xfd, 0xdf, 0x81, 0xcf, 0xd3, 0xcf, 0xe7, 0xe1, 0x8f, 0xfc, 0x1f, 0xff, 0xbf};

const unsigned char washing_bmp[] PROGMEM = {
	// 'Miele Waschmaschine, 128x64px
	0xff, 0xff, 0xff, 0xff, 0xff, 0xff, 0xf0, 0x0f, 0xff, 0xff, 0xff, 0xff,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 0xff, 0xff};

void OledDisplayManager::setupOledDisplay()
{
	// SSD1306_SWITCHCAPVCC = generate display voltage from 3.3V internally
	if (!display.begin(SSD1306_SWITCHCAPVCC, 0x3C))
	{
		Serial.println(F("SSD1306 allocation failed"));
		for (;;)
			; // Don't proceed, loop forever
	}

	// Show initial display buffer contents on the screen --
	// the library initializes this with an Adafruit splash screen.
	display.display();
	delay(2000);
	display.clearDisplay();
	display.setTextSize(1);
	display.setTextColor(WHITE);
	display.setCursor(0, 10);
	display.println("IoT Domi & Tim");
	display.println("Smart Washing Machine");

	display.display();
	delay(2000);

	display.clearDisplay();
	display.drawBitmap(0, 0, washing_bmp, 128, 64, WHITE);
	display.display();
}

void OledDisplayManager::showAccelerometerDetails(sensors_event_t *pEvent, int textSize, int rssi, bool isInfluxConnected)
{
	sensors_event_t event = *pEvent;
	display.clearDisplay();
	display.setTextSize(textSize);
	display.setCursor(0, 10);
	display.println("X: " + String(event.acceleration.x, 2));
	display.println("Y: " + String(event.acceleration.y, 2));
	display.println("Z: " + String(event.acceleration.z, 2));
	showSignalStrength(rssi);
	printLocalTime();
	if (isInfluxConnected)
	{
		display.drawBitmap(102, 10, influxdb_bmp, 16, 16, WHITE);
	}

	display.display();
}

void OledDisplayManager::showSignalStrength(int rssi)
{
	int rectNumber = 4;
	int quality = 2 * (rssi + 100);
	int bulks = (rectNumber * quality) / 100;
	// Test code -> Draw Signal Strength of WIFI -> https://forum.arduino.cc/t/wifi-bars-for-uno-wifi-rev2-with-oled-display/866644/3
	display.drawRect(102, 7, 4, 1, WHITE);
	display.drawRect(107, 6, 4, 2, WHITE);
	display.drawRect(112, 4, 4, 4, WHITE);
	display.drawRect(117, 2, 4, 6, WHITE);
	display.drawRect(122, 0, 4, 8, WHITE);

	switch (bulks)
	{
	case 1:
		display.fillRect(102, 7, 4, 1, WHITE);
		break;
	case 2:
		display.fillRect(102, 7, 4, 1, WHITE);
		display.fillRect(107, 6, 4, 2, WHITE);
		break;
	case 3:
		display.fillRect(102, 7, 4, 1, WHITE);
		display.fillRect(107, 6, 4, 2, WHITE);
		display.fillRect(112, 4, 4, 4, WHITE);
		break;
	case 4:
		display.fillRect(102, 7, 4, 1, WHITE);
		display.fillRect(107, 6, 4, 2, WHITE);
		display.fillRect(112, 4, 4, 4, WHITE);
		display.fillRect(117, 2, 4, 6, WHITE);
		break;
	case 5:
		display.fillRect(102, 7, 4, 1, WHITE);
		display.fillRect(107, 6, 4, 2, WHITE);
		display.fillRect(112, 4, 4, 4, WHITE);
		display.fillRect(117, 2, 4, 6, WHITE);
		display.fillRect(122, 0, 4, 8, WHITE);
		break;
	default:
		break;
	}
}

void OledDisplayManager::printLocalTime()
{
	struct tm timeinfo;
	if (!getLocalTime(&timeinfo))
	{
		Serial.println("Failed to obtain time");
		return;
	}
	display.setTextSize(1);
	display.setCursor(0, 0);
	display.println(&timeinfo, "%d-%m-%Y %H:%M");
}